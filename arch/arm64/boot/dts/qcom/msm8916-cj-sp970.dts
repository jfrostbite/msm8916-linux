// SPDX-License-Identifier: GPL-2.0-only

/dts-v1/;

#include "msm8916-ufi.dtsi"

/ {
 	model = "SP970v8 4G Modem Stick";
 	compatible = "cj,sp970", "qcom,msm8916", "lk2nd,device";

	usb_id: usb-id {
		compatible = "linux,extcon-usb-gpio";
		id-gpios = <&tlmm 110 GPIO_ACTIVE_HIGH>;
		pinctrl-0 = <&usb_id_default>;
		pinctrl-names = "default";
	};
};

$cpu_opp_table {
	opp-1094400000 {
		opp-hz = /bits/ 64 <1094400000>;
	};
	opp-1152000000 {
		opp-hz = /bits/ 64 <1152000000>;
	};
	opp-1209600000 {
		opp-hz = /bits/ 64 <1209600000>;
	};
	opp-1248000000 {
		opp-hz = /bits/ 64 <1248000000>;
	};
	opp-1363200000 {
		opp-hz = /bits/ 64 <1363200000>;
	};
	opp-1401600000 {
		opp-hz = /bits/ 64 <1401600000>;
	};
	opp-1459200000 {
		opp-hz = /bits/ 64 <1459200000>;
	};
	opp-1516800000 {
		opp-hz = /bits/ 64 <1516800000>;
	};
	opp-1574400000 {
		opp-hz = /bits/ 64 <1574400000>;
	};
	opp-1632000000 {
		opp-hz = /bits/ 64 <1632000000>;
	};
	opp-1689600000 {
		opp-hz = /bits/ 64 <1689600000>;
	};
	opp-1747200000 {
		opp-hz = /bits/ 64 <1747200000>;
	};
	opp-1804800000 {
		opp-hz = /bits/ 64 <1804800000>;
	};
	opp-1862400000 {
		opp-hz = /bits/ 64 <1862400000>;
	};
	opp-1920000000 {
		opp-hz = /bits/ 64 <1920000000>;
	};
	opp-1977600000 {
		opp-hz = /bits/ 64 <1977600000>;
	};
	opp-2035200000 {
		opp-hz = /bits/ 64 <2035200000>;
	};
	opp-2092800000 {
		opp-hz = /bits/ 64 <2092800000>;
	};
};

&button_restart {
	gpios = <&tlmm 107 GPIO_ACTIVE_LOW>;
};

&led_b {
	gpios = <&tlmm 28 GPIO_ACTIVE_HIGH>;
};

&led_g {
	gpios = <&tlmm 10 GPIO_ACTIVE_HIGH>;
};

&led_r {
	gpios = <&tlmm 9 GPIO_ACTIVE_HIGH>;
};

&mpss {
	pinctrl-0 = <&sim_ctrl_default>;
	pinctrl-names = "default";
};

&wcnss_iris {
	compatible = "qcom,wcn3660b";
};

&usb {
	extcon = <&usb_id>, <&usb_id>;

	status = "okay";
};

&usb_hs_phy {
	extcon = <&usb_id>;
};

&button_default {
	pins = "gpio107";
	bias-pull-up;
};

&gpio_leds_default {
	pins = "gpio28", "gpio10", "gpio9";
};

/* This selects the external SIM card slot by default */
&tlmm {
	sim_ctrl_default: sim-ctrl-default-state {
		pins = "gpio120", "gpio114";
		function = "gpio";
		drive-strength = <2>;
		bias-disable;

		sim-en-pins {
			label = "sim:en";
			gpios = <&tlmm 120 GPIO_ACTIVE_HIGH>;
			default-state = "on";
		};

		sim-sel-pins {
			label = "sim:sel";
			gpios = <&tlmm 114 GPIO_ACTIVE_HIGH>;
			default-state = "off";
		};
	};

	usb_id_default: usb-id-default-state {
		pins = "gpio110";
		function = "gpio";

		drive-strength = <8>;
		bias-pull-up;
	};
};
