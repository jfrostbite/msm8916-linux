/dts-v1/;

#include "qcom-mdm9607-mtp.dtsi"

/ {
	model = "Qualcomm Technologies, Inc. MDM 9607 MTP";
	compatible = "qcom,mdm9607-mtp", "qcom,mdm9607", "qcom,mtp";
	qcom,msm-id = <0x122 0x10000 0x128 0x10000 0x129 0x10000 0x12a 0x10000 0x12b 0x10000>;
	qcom,board-id = <8 0>;
};